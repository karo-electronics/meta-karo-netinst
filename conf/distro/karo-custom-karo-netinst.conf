## conf/distro/karo-custom-karo-netinst.conf
```bitbake
require conf/distro/include/karo-distro.inc

DISTRO = "karo-custom-karo-netinst"
DISTRO_NAME = "Debian 12 Netinstaller"

DISTRO_FEATURES = ""

PARTITIONS_IMAGE:remove = " \
	karo-image-userfs \
	karo-image-netinst \
"

BOOTFS_PARTITION_SIZE = "262144"
ROOTFS_PARTITION_SIZE = "0"
```

## conf/layer.conf
```bitbake
# We have a conf and classes directory, add to BBPATH
BBPATH .= ":${LAYERDIR}"

# We have recipes-* directories, add to BBFILES
BBFILES += "${LAYERDIR}/recipes-*/*/*.bb \
            ${LAYERDIR}/recipes-*/*/*.bbappend"

BBFILE_COLLECTIONS += "meta-karo-netinst"
BBFILE_PATTERN_meta-karo-netinst = "^${LAYERDIR}/"
BBFILE_PRIORITY_meta-karo-netinst = "7"

LAYERDEPENDS_meta-karo-netinst = "karo-nxp"
LAYERSERIES_COMPAT_meta-karo-netinst = "langdale mickledore"
```
